## sdkconfig.defaults
```kconfig
# Fishtank Controller - ESP-IDF Configuration Defaults
# Target: ESP32-C6 (Seeed XIAO ESP32-C6)

# =============================================================================
# Target and Flash Configuration
# =============================================================================
CONFIG_IDF_TARGET="esp32c6"
CONFIG_ESPTOOLPY_FLASHSIZE_4MB=y
CONFIG_ESPTOOLPY_FLASHMODE_QIO=y
CONFIG_ESPTOOLPY_FLASHFREQ_80M=y

# =============================================================================
# Partition Table
# =============================================================================
CONFIG_PARTITION_TABLE_CUSTOM=y
CONFIG_PARTITION_TABLE_CUSTOM_FILENAME="partitions.csv"

# =============================================================================
# FreeRTOS Configuration
# =============================================================================
CONFIG_FREERTOS_HZ=1000
CONFIG_FREERTOS_TIMER_TASK_STACK_DEPTH=3072
CONFIG_FREERTOS_IDLE_TASK_STACKSIZE=2048

# =============================================================================
# WiFi Configuration
# =============================================================================
CONFIG_ESP_WIFI_SOFTAP_SUPPORT=y
CONFIG_ESP_WIFI_NVS_ENABLED=y
CONFIG_ESP_WIFI_STATIC_RX_BUFFER_NUM=10
CONFIG_ESP_WIFI_DYNAMIC_RX_BUFFER_NUM=32
CONFIG_ESP_WIFI_TX_BUFFER_TYPE=1
CONFIG_ESP_WIFI_DYNAMIC_TX_BUFFER_NUM=32
CONFIG_ESP_WIFI_AMPDU_TX_ENABLED=y
CONFIG_ESP_WIFI_AMPDU_RX_ENABLED=y

# =============================================================================
# LWIP / Network Configuration
# =============================================================================
CONFIG_LWIP_DHCPS=y
CONFIG_LWIP_DHCP_RESTORE_LAST_IP=y
CONFIG_LWIP_SNTP_MAX_SERVERS=3
CONFIG_LWIP_MAX_SOCKETS=16

# =============================================================================
# HTTP Server Configuration
# =============================================================================
CONFIG_HTTPD_MAX_REQ_HDR_LEN=1024
CONFIG_HTTPD_MAX_URI_LEN=512
CONFIG_HTTPD_ERR_RESP_NO_DELAY=y
CONFIG_HTTPD_WS_SUPPORT=y
CONFIG_HTTPD_QUEUE_WORK_BLOCKING=y

# =============================================================================
# MQTT Configuration
# =============================================================================
CONFIG_MQTT_PROTOCOL_5=y
CONFIG_MQTT_TRANSPORT_SSL=y
CONFIG_MQTT_TRANSPORT_WEBSOCKET=y
CONFIG_MQTT_BUFFER_SIZE=1024
CONFIG_MQTT_TASK_STACK_SIZE=6144

# =============================================================================
# mDNS Configuration
# =============================================================================
CONFIG_MDNS_MAX_SERVICES=10

# =============================================================================
# NVS Configuration
# =============================================================================
CONFIG_NVS_ENCRYPTION=n

# =============================================================================
# Logging Configuration
# =============================================================================
CONFIG_LOG_DEFAULT_LEVEL_INFO=y
CONFIG_LOG_MAXIMUM_LEVEL_DEBUG=y

# =============================================================================
# OTA Configuration
# =============================================================================
CONFIG_BOOTLOADER_APP_ROLLBACK_ENABLE=y
CONFIG_BOOTLOADER_APP_ANTI_ROLLBACK=n

# =============================================================================
# I2C Configuration (for POET sensor and OLED display)
# =============================================================================
CONFIG_I2C_ISR_IRAM_SAFE=y

# =============================================================================
# TLS/SSL Configuration (for secure MQTT)
# =============================================================================
CONFIG_ESP_TLS_USING_MBEDTLS=y
CONFIG_MBEDTLS_SSL_MAX_CONTENT_LEN=16384
CONFIG_MBEDTLS_CERTIFICATE_BUNDLE=y
CONFIG_MBEDTLS_CERTIFICATE_BUNDLE_DEFAULT_CMN=y

# =============================================================================
# LittleFS Configuration (for web UI assets)
# =============================================================================
CONFIG_LITTLEFS_MAX_PARTITIONS=3
CONFIG_LITTLEFS_PAGE_SIZE=256
CONFIG_LITTLEFS_OBJ_NAME_LEN=64

# =============================================================================
# Core Dump Configuration (for debugging)
# =============================================================================
CONFIG_ESP_COREDUMP_ENABLE_TO_FLASH=y
CONFIG_ESP_COREDUMP_DATA_FORMAT_ELF=y
CONFIG_ESP_COREDUMP_CHECKSUM_CRC32=y

# =============================================================================
# Watchdog Configuration
# =============================================================================
CONFIG_ESP_TASK_WDT_EN=y
CONFIG_ESP_TASK_WDT_TIMEOUT_S=10
CONFIG_ESP_TASK_WDT_CHECK_IDLE_TASK_CPU0=y
```

## src/Kconfig.projbuild
```kconfig
menu "Fishtank Controller Configuration"

    config FISHTANK_UNIT_NAME
        string "Default unit name"
        default "Aquarium"
        help
            Default device name used for mDNS and MQTT topics.
            Can be changed at runtime via web UI.

    menu "I2C Configuration"
        config FISHTANK_I2C_SDA_GPIO
            int "I2C SDA GPIO"
            default 6
            help
                GPIO number for I2C data line.

        config FISHTANK_I2C_SCL_GPIO
            int "I2C SCL GPIO"
            default 7
            help
                GPIO number for I2C clock line.

        config FISHTANK_I2C_FREQ_HZ
            int "I2C frequency (Hz)"
            default 400000
            help
                I2C bus frequency. POET sensor supports up to 400kHz.
    endmenu

    menu "POET Sensor Configuration"
        config FISHTANK_POET_I2C_ADDR
            hex "POET sensor I2C address"
            default 0x1F
            help
                I2C address of the POET pH/ORP/EC/Temperature sensor.

        config FISHTANK_SENSOR_READ_INTERVAL_MS
            int "Sensor read interval (ms)"
            default 5000
            help
                Interval between sensor readings in milliseconds.
    endmenu

    menu "Display Configuration"
        config FISHTANK_DISPLAY_I2C_ADDR
            hex "SSD1306 display I2C address"
            default 0x3C
            help
                I2C address of the SSD1306 OLED display.
                Common values: 0x3C or 0x3D.

        config FISHTANK_DISPLAY_WIDTH
            int "Display width (pixels)"
            default 128

        config FISHTANK_DISPLAY_HEIGHT
            int "Display height (pixels)"
            default 32

        config FISHTANK_DISPLAY_CYCLE_MS
            int "Display metric cycle interval (ms)"
            default 3000
            help
                Time to display each metric before cycling to next.
    endmenu

    menu "WiFi Provisioning"
        config FISHTANK_WIFI_AP_SSID
            string "Provisioning AP SSID"
            default "AquariumSetup"
            help
                SSID for WiFi provisioning access point.

        config FISHTANK_WIFI_AP_PASS
            string "Provisioning AP password"
            default "aquarium123"
            help
                Password for WiFi provisioning access point.
                Must be at least 8 characters.
    endmenu

    menu "MQTT Configuration"
        config FISHTANK_MQTT_BUFFER_SIZE
            int "MQTT buffer size"
            default 1024
            help
                Size of MQTT send/receive buffers.

        config FISHTANK_MQTT_RECONNECT_TIMEOUT_MS
            int "MQTT reconnect timeout (ms)"
            default 5000
            help
                Initial reconnection timeout. Uses exponential backoff.
    endmenu

    menu "OTA Configuration"
        config FISHTANK_OTA_ROLLBACK_TIMEOUT_S
            int "OTA rollback timeout (seconds)"
            default 300
            help
                Time after boot to confirm OTA update before automatic rollback.
                Set to 0 to disable automatic rollback.
    endmenu

endmenu
```
